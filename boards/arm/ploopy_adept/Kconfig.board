## boards/arm/ploopy_adept/Kconfig.board
```kconfig
# Copyright (c) 2025, George Norton
# SPDX-License-Identifier: MIT

config BOARD_PLOOPY_ADEPT
    bool "ploopy_adept"
    depends on SOC_RP2040
    select ZMK_MOUSE
    select pinctrl
    select INPUT
    select INPUT_PIXART_PMW3360
    select RP2040_SLEEP
```

## boards/arm/ploopy_adept/Kconfig.defconfig
```kconfig
# Copyright (c) 2025, George Norton
# SPDX-License-Identifier: MIT

if BOARD_PLOOPY_ADEPT

config BOARD
    default "ploopy_adept"

config RP2_FLASH_W25Q080
    default y

endif # BOARD_PLOOPY_ADEPT
```

## boards/arm/ploopy_classic_2/Kconfig.board
```kconfig
# Copyright (c) 2025, George Norton
# SPDX-License-Identifier: MIT

config BOARD_PLOOPY_CLASSIC_2
    bool "ploopy_classic_2"
    depends on SOC_RP2040
    select ZMK_MOUSE
    select pinctrl
    select INPUT
    select INPUT_PIXART_PMW3360
    select PLOOPY_OPTICAL_ENCODER
    select RP2040_SLEEP
```

## boards/arm/ploopy_mouse/Kconfig.board
```kconfig
# Copyright (c) 2025, George Norton
# SPDX-License-Identifier: MIT

config BOARD_PLOOPY_MOUSE
    bool "ploopy_mouse"
    depends on SOC_RP2040
    imply ZMK_MOUSE
    select pinctrl
    select GPIO
    select INPUT
    select SPI
    select INPUT_PIXART_PMW3360
```

## boards/arm/ploopy_mouse/Kconfig.defconfig
```kconfig
# Copyright (c) 2025, George Norton
# SPDX-License-Identifier: MIT

if BOARD_PLOOPY_MOUSE

config BOARD
    default "ploopy_mouse"

config RP2_FLASH_W25Q080
    default y

endif # BOARD_PLOOPY_MOUSE
```

## boards/arm/ploopy_mouse/ploopy_mouse_defconfig
```kconfig
# Copyright (c) 2025 George Norton
# SPDX-License-Identifier: MIT

CONFIG_SOC_SERIES_RP2XXX=y
CONFIG_SOC_RP2040=y
CONFIG_BOARD_PLOOPY_MOUSE=y

CONFIG_SYS_CLOCK_HW_CYCLES_PER_SEC=125000000

# Enable USB CDC ACM logging for debugging
# CONFIG_ZMK_USB_LOGGING=y

# Enable reset by default
CONFIG_RESET=y

# Code partition needed to target the correct flash range
CONFIG_USE_DT_CODE_PARTITION=y

# Output UF2 by default, native bootloader supports it.
CONFIG_BUILD_OUTPUT_UF2=y

# CONFIG_INPUT_LOG_LEVEL_DBG=y
# CONFIG_LOG_PROCESS_THREAD_STARTUP_DELAY_MS=2000

CONFIG_ZMK_USB=y
CONFIG_ZMK_MOUSE=y

CONFIG_MPU_ALLOW_FLASH_WRITE=y
CONFIG_NVS=y
CONFIG_SETTINGS_NVS=y
CONFIG_FLASH=y
CONFIG_FLASH_PAGE_LAYOUT=y
CONFIG_FLASH_MAP=y
CONFIG_SETTINGS=y

CONFIG_ZMK_PHYSICAL_LAYOUT_KEY_ROTATION=y
CONFIG_ZMK_STUDIO=y
```

## boards/ploopyco/ploopy_adept/Kconfig.ploopy_adept
```kconfig
# Copyright (c) 2025, George Norton
# SPDX-License-Identifier: Apache-2.0

config BOARD_PLOOPY_ADEPT
	select SOC_RP2040
```

## boards/ploopyco/ploopy_adept/ploopy_adept_defconfig
```kconfig
# Copyright (c) 2025 George Norton
# SPDX-License-Identifier: MIT

CONFIG_SYS_CLOCK_HW_CYCLES_PER_SEC=125000000

# Enable reset by default
CONFIG_RESET=y
CONFIG_CLOCK_CONTROL=y

# Code partition needed to target the correct flash range
CONFIG_USE_DT_CODE_PARTITION=y

# Output UF2 by default, native bootloader supports it.
CONFIG_BUILD_OUTPUT_UF2=y

CONFIG_ZMK_USB=y
CONFIG_ZMK_MOUSE=y
# May not work well on MacOS
# CONFIG_ZMK_POINTING_SMOOTH_SCROLLING=y

# Required for persistant settings (mouse wheel DPI and studio keymaps)
CONFIG_MPU_ALLOW_FLASH_WRITE=y
CONFIG_NVS=y
CONFIG_SETTINGS_NVS=y
CONFIG_FLASH=y
CONFIG_FLASH_PAGE_LAYOUT=y
CONFIG_FLASH_MAP=y
CONFIG_SETTINGS=y

CONFIG_ZMK_STUDIO=y
```

## boards/ploopyco/ploopy_classic_2/Kconfig.defconfig
```kconfig
# Copyright (c) 2025, George Norton
# SPDX-License-Identifier: MIT

if BOARD_PLOOPY_CLASSIC_2

config RP2_FLASH_W25Q080
    default y

endif # BOARD_PLOOPY_CLASSIC_2
```

## boards/ploopyco/ploopy_classic_2/Kconfig.ploopy_classic_2
```kconfig
# Copyright (c) 2025, George Norton
# SPDX-License-Identifier: Apache-2.0

config BOARD_PLOOPY_CLASSIC_2
	select SOC_RP2040
```

## boards/ploopyco/ploopy_mouse/Kconfig.ploopy_mouse
```kconfig
# Copyright (c) 2025, George Norton
# SPDX-License-Identifier: Apache-2.0

config BOARD_PLOOPY_MOUSE
	select SOC_RP2040
```

## config/west.yml
```yaml
manifest:
  remotes:
    - name: zmkfirmware
      url-base: https://github.com/zmkfirmware
    - name: george-norton
      url-base: https://github.com/george-norton
  projects:
    - name: zmk
      remote: zmkfirmware
      revision: v0.2.1
      import: app/west.yml
    - name: zmk-driver-pmw3360
      remote: george-norton
      revision: v0.2
    - name: zmk-behavior-sensor-attr-cycle
      remote: george-norton
      revision: v0.2
    - name: zmk-driver-rp2040-sleep
      remote: george-norton
      revision: v0.2
```

## drivers/sensor/ploopy_optical_encoder/Kconfig
```kconfig
# Copyright (c) 2025 George Norton
# SPDX-License-Identifier: MIT

menuconfig PLOOPY_OPTICAL_ENCODER
    bool "Ploopy Optical Encoder Sensor"
    default y
    depends on DT_HAS_PLOOPY_OPTICAL_ENCODER_ENABLED
    select ADC
    help
      Enable driver for Ploopy Optical encoder sensors.
```

## dts/bindings/sensor/ploopy,optical-encoder.yaml
```yaml
# Copyright (c) 2025 George Norton
# SPDX-License-Identifier: MIT

description: |
  A sensor driver that polls ADC pins to sample the light sensors on Ploopys optical scroll wheels.

compatible: "ploopy,optical-encoder"

properties:
  event-startup-delay:
    type: int
    default: 0
    description: Milliseconds to delay before starting generating the events
  poll-period:
    type: int
    description: Milliseconds between each ADC poll
  io-channels:
    required: true
    type: phandle-array
    description: Two ADC channels connected to the light sensors
  steps:
    type: int
    required: true
    description: The number of steps per full rotation
```
